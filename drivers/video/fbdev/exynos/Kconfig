## drivers/video/fbdev/exynos/Kconfig
```kconfig
MCD_PANEL_PATH := drivers/video/fbdev/exynos/panel
source "drivers/video/fbdev/exynos/dpu30/Kconfig"
source "drivers/video/fbdev/exynos/panel/Kconfig"
source "drivers/video/fbdev/exynos/dp_logger/Kconfig"
```
